## CMakeLists.txt
```
cmake_minimum_required(VERSION 3.20.0)

find_package(Zephyr REQUIRED HINTS $ENV{ZEPHYR_BASE})
project(bikeshare_firmware)

target_sources(app PRIVATE
	src/main.c
	src/app_channels.c
	src/button_input.c
	src/bike_config.c
	src/bike_shell.c
	src/bike_state.c
	src/led_status.c
)

target_include_directories(app PRIVATE include)
```

## prj.conf
```kconfig
CONFIG_LOG=y
CONFIG_LOG_DEFAULT_LEVEL=3

CONFIG_CONSOLE=y
CONFIG_PRINTK=y

# Shell via UART
CONFIG_SHELL=y
CONFIG_SHELL_BACKEND_SERIAL=y
CONFIG_SHELL_LOG_BACKEND=y

# zbus
CONFIG_ZBUS=y

# Settings. native_sim keeps a runtime backend; nRF9160 overrides this with NVS.
CONFIG_SETTINGS=y
CONFIG_SETTINGS_RUNTIME=y
```

## boards/native_sim_native_64.conf
```kconfig
# Native simulator networking for local development.
CONFIG_NETWORKING=y
CONFIG_NET_IPV4=y
CONFIG_NET_TCP=y
CONFIG_NET_SOCKETS=y
CONFIG_NET_L2_ETHERNET=y
CONFIG_ETH_NATIVE_TAP=y
CONFIG_HEAP_MEM_POOL_SIZE=4096

# Static firmware IP. The host side of the zeth TAP setup is 192.0.2.2.
CONFIG_NET_CONFIG_SETTINGS=y
CONFIG_NET_CONFIG_MY_IPV4_ADDR="192.0.2.1"
CONFIG_NET_CONFIG_MY_IPV4_NETMASK="255.255.255.0"
CONFIG_NET_CONFIG_MY_IPV4_GW="192.0.2.2"
```

## boards/nrf9160dk_nrf9160_ns.conf
```kconfig
# nRF9160 DK hardware scaffold.
#
# This upstream-Zephyr manifest can build the board skeleton and persistent
# settings path. LTE modem, GNSS, and Nordic modem library options belong in
# the later NCS manifest/config because those symbols are not provided by
# upstream Zephyr.

# Hardware shell/log console.
CONFIG_SERIAL=y
CONFIG_UART_CONSOLE=y
CONFIG_SHELL_BACKEND_SERIAL=y

# Board peripherals used by the planned LED and button modules.
CONFIG_GPIO=y

# Persistent Settings backend for hardware configuration.
CONFIG_SETTINGS_RUNTIME=n
CONFIG_FLASH=y
CONFIG_FLASH_PAGE_LAYOUT=y
CONFIG_FLASH_MAP=y
CONFIG_NVS=y
CONFIG_SETTINGS_NVS=y
CONFIG_SETTINGS_NVS_SECTOR_COUNT=4
CONFIG_MPU_ALLOW_FLASH_WRITE=y

# Generic network/MQTT libraries for the future hardware transport modules.
CONFIG_NETWORKING=y
CONFIG_NET_IPV4=y
CONFIG_NET_TCP=y
CONFIG_NET_SOCKETS=y
CONFIG_MQTT_LIB=y
CONFIG_HEAP_MEM_POOL_SIZE=8192
```

## boards/nrf9160dk_nrf9160_ns.overlay
```dts
/ {
	chosen {
		zephyr,settings-partition = &storage_partition;
	};
};
```

## src/main.c
```c
#include <zephyr/kernel.h>
#include <zephyr/logging/log.h>

#include "button_input.h"
#include "bike_config.h"
#include "bike_state.h"
#include "led_status.h"

LOG_MODULE_REGISTER(bikeshare, LOG_LEVEL_INF);

int main(void)
{
	LOG_INF("Bikeshare Firmware iniciando...");

	bike_config_init();
	led_status_init();
	button_input_init();
	bike_state_init();

	LOG_INF("ID: %s", bike_config_get_id()[0]
		? bike_config_get_id() : "(nao configurado)");
	LOG_INF("Estado: %s", bike_state_name(bike_state_get()));

	return 0;
}
```

## include/app_channels.h
```c
#pragma once

#include <stdint.h>

#include <zephyr/zbus/zbus.h>

#include "bike_config.h"
#include "bike_state.h"

#define BIKE_RENTAL_ID_MAX_LEN 32

enum bike_backend_command_type {
	BIKE_BACKEND_RENT_AUTHORIZE,
	BIKE_BACKEND_RENT_CANCEL,
};

struct bike_button_event_msg {
	int64_t uptime_ms;
};

struct bike_backend_command_msg {
	enum bike_backend_command_type type;
	char rental_id[BIKE_RENTAL_ID_MAX_LEN];
};

struct bike_state_msg {
	enum bike_state_value state;
	char rental_id[BIKE_RENTAL_ID_MAX_LEN];
	int64_t updated_at_ms;
};

struct telemetry_sample_msg {
	char bike_id[BIKE_ID_MAX_LEN];
	enum bike_state_value state;
	int64_t uptime_ms;
	bool gnss_fix_valid;
};

ZBUS_CHAN_DECLARE(button_event_chan);
ZBUS_CHAN_DECLARE(backend_command_chan);
ZBUS_CHAN_DECLARE(bike_state_chan);
ZBUS_CHAN_DECLARE(telemetry_sample_chan);
```

## include/bike_config.h
```c
#pragma once

#define BIKE_ID_MAX_LEN     32
#define BIKE_TOKEN_MAX_LEN  128
#define BIKE_URL_MAX_LEN    128

int bike_config_init(void);

const char *bike_config_get_id(void);
const char *bike_config_get_token(void);
const char *bike_config_get_url(void);

int bike_config_set_id(const char *id);
int bike_config_set_token(const char *token);
int bike_config_set_url(const char *url);
```

## include/led_status.h
```c
#pragma once

#include <stdbool.h>

#include "bike_state.h"

enum led_status_pattern {
	LED_STATUS_OFF,
	LED_STATUS_SOLID_ON,
	LED_STATUS_BLINK_SLOW,
	LED_STATUS_BLINK_FAST,
	LED_STATUS_ERROR,
};

int led_status_init(void);
enum led_status_pattern led_status_pattern_for_state(enum bike_state_value state);
enum led_status_pattern led_status_get_pattern(void);
bool led_status_is_on(void);
const char *led_status_pattern_name(enum led_status_pattern pattern);
```

## src/app_channels.c
```c
#include "app_channels.h"

ZBUS_CHAN_DEFINE(button_event_chan,
		 struct bike_button_event_msg,
		 NULL,
		 NULL,
		 ZBUS_OBSERVERS_EMPTY,
		 ZBUS_MSG_INIT(0));

ZBUS_CHAN_DEFINE(backend_command_chan,
		 struct bike_backend_command_msg,
		 NULL,
		 NULL,
		 ZBUS_OBSERVERS_EMPTY,
		 ZBUS_MSG_INIT(0));

ZBUS_CHAN_DEFINE(bike_state_chan,
		 struct bike_state_msg,
		 NULL,
		 NULL,
		 ZBUS_OBSERVERS_EMPTY,
		 ZBUS_MSG_INIT(.state = BIKE_STATE_UNREGISTERED));

ZBUS_CHAN_DEFINE(telemetry_sample_chan,
		 struct telemetry_sample_msg,
		 NULL,
		 NULL,
		 ZBUS_OBSERVERS_EMPTY,
		 ZBUS_MSG_INIT(0));
```

## src/bike_config.c
```c
#include <errno.h>
#include <stdlib.h>
#include <string.h>

#include <zephyr/logging/log.h>
#include <zephyr/settings/settings.h>

#include "bike_config.h"

LOG_MODULE_REGISTER(bike_config, LOG_LEVEL_INF);

static struct bike_config cfg;

static int read_string_setting(size_t len, settings_read_cb read_cb,
			       void *cb_arg, char *buf, size_t buf_len)
{
	int rc;

	if (len >= buf_len) {
		return -EINVAL;
	}

	rc = read_cb(cb_arg, buf, len);
	if (rc < 0) {
		return rc;
	}
	if ((size_t)rc >= buf_len) {
		return -EINVAL;
	}

	buf[rc] = '\0';
	return 0;
}

static int settings_set_cb(const char *key, size_t len,
			   settings_read_cb read_cb, void *cb_arg)
{
	const char *next;

	if (settings_name_steq(key, "id", &next) && !next) {
		return read_string_setting(len, read_cb, cb_arg, cfg.id,
					   sizeof(cfg.id));
	}

	if (settings_name_steq(key, "device_token", &next) && !next) {
		return read_string_setting(len, read_cb, cb_arg, cfg.device_token,
					   sizeof(cfg.device_token));
	}

	if (settings_name_steq(key, "mqtt_host", &next) && !next) {
		return read_string_setting(len, read_cb, cb_arg, cfg.mqtt_host,
					   sizeof(cfg.mqtt_host));
	}

	if (settings_name_steq(key, "mqtt_port", &next) && !next) {
		char port_str[BIKE_MQTT_PORT_MAX_LEN];
		int rc = read_string_setting(len, read_cb, cb_arg, port_str,
					     sizeof(port_str));

		if (rc) {
			return rc;
		}

		uint16_t port;

		rc = bike_config_parse_mqtt_port(port_str, &port);
		if (rc) {
			return rc;
		}

		cfg.mqtt_port = port;
		return 0;
	}

	if (settings_name_steq(key, "apn", &next) && !next) {
		return read_string_setting(len, read_cb, cb_arg, cfg.apn,
					   sizeof(cfg.apn));
	}

	return -ENOENT;
}

SETTINGS_STATIC_HANDLER_DEFINE(bike, "bike", NULL, settings_set_cb, NULL, NULL);

int bike_config_init(void)
{
	int rc = settings_subsys_init();

	if (rc) {
		LOG_ERR("Falha ao inicializar configuracoes: %d", rc);
		return rc;
	}

	rc = settings_load();

	if (rc) {
		LOG_ERR("Falha ao carregar configuracoes: %d", rc);
	}

	return rc;
}

const struct bike_config *bike_config_get(void)
{
	return &cfg;
}

const char *bike_config_get_id(void)
{
	return cfg.id;
}

const char *bike_config_get_device_token(void)
{
	return cfg.device_token;
}

const char *bike_config_get_mqtt_host(void)
{
	return cfg.mqtt_host;
}

uint16_t bike_config_get_mqtt_port(void)
{
	return cfg.mqtt_port;
}

const char *bike_config_get_apn(void)
{
	return cfg.apn;
}

static int validate_required_string(const char *value, size_t buf_len)
{
	size_t len;

	if (!value) {
		return -EINVAL;
	}

	len = strlen(value);
	if (len == 0 || len >= buf_len) {
		return -EINVAL;
	}

	return 0;
}

int bike_config_parse_mqtt_port(const char *value, uint16_t *port)
{
	char *endptr;
	long parsed;

	if (!value || !value[0] || !port) {
		return -EINVAL;
	}

	parsed = strtol(value, &endptr, 10);
	if (*endptr != '\0' || parsed < 1 || parsed > UINT16_MAX) {
		return -EINVAL;
	}

	*port = (uint16_t)parsed;
	return 0;
}

bool bike_config_is_valid(const struct bike_config *config)
{
	return config &&
	       config->id[0] &&
	       config->device_token[0] &&
	       config->mqtt_host[0] &&
	       config->mqtt_port >= 1 &&
	       config->apn[0];
}

static int save_string_field(const char *settings_key, const char *value,
			     char *buf, size_t buf_len)
{
	size_t len;
	int rc;

	rc = validate_required_string(value, buf_len);
	if (rc) {
		return rc;
	}

	len = strlen(value);
	memcpy(buf, value, len + 1);

#if defined(CONFIG_SETTINGS_RUNTIME)
	return settings_runtime_set(settings_key, buf, len);
#else
	return settings_save_one(settings_key, buf, len);
#endif
}

int bike_config_set_id(const char *id)
{
	return save_string_field("bike/id", id, cfg.id, sizeof(cfg.id));
}

int bike_config_set_device_token(const char *token)
{
	return save_string_field("bike/device_token", token, cfg.device_token,
				 sizeof(cfg.device_token));
}

int bike_config_set_mqtt_host(const char *host)
{
	return save_string_field("bike/mqtt_host", host, cfg.mqtt_host,
				 sizeof(cfg.mqtt_host));
}

int bike_config_set_mqtt_port(uint16_t port)
{
	char port_str[BIKE_MQTT_PORT_MAX_LEN];
	int len;

	if (port < 1) {
		return -EINVAL;
	}

	cfg.mqtt_port = port;
	len = snprintk(port_str, sizeof(port_str), "%u", port);
	if (len <= 0 || len >= sizeof(port_str)) {
		return -EINVAL;
	}

#if defined(CONFIG_SETTINGS_RUNTIME)
	return settings_runtime_set("bike/mqtt_port", port_str, len);
#else
	return settings_save_one("bike/mqtt_port", port_str, len);
#endif
}

int bike_config_set_apn(const char *apn)
{
	return save_string_field("bike/apn", apn, cfg.apn, sizeof(cfg.apn));
}
```

## src/bike_shell.c
```c
#include <errno.h>
#include <string.h>

#include <zephyr/kernel.h>
#include <zephyr/shell/shell.h>
#include <zephyr/zbus/zbus.h>

#include "app_channels.h"
#include "bike_config.h"
#include "bike_state.h"

static int refresh_state_after_config(const struct shell *sh)
{
	int rc = bike_state_refresh_config();

	if (rc) {
		shell_error(sh, "Falha ao atualizar estado: %d", rc);
	}

	return rc;
}

static int cmd_bike_set_id(const struct shell *sh, size_t argc, char **argv)
{
	ARG_UNUSED(argc);

	int rc = bike_config_set_id(argv[1]);

	if (rc) {
		shell_error(sh, "Erro ao salvar ID: %d", rc);
		return rc;
	}

	shell_print(sh, "ID configurado: %s", argv[1]);
	return refresh_state_after_config(sh);
}

static int cmd_bike_set_token(const struct shell *sh, size_t argc, char **argv)
{
	ARG_UNUSED(argc);

	int rc = bike_config_set_device_token(argv[1]);

	if (rc) {
		shell_error(sh, "Erro ao salvar token: %d", rc);
		return rc;
	}

	shell_print(sh, "Token configurado.");
	return refresh_state_after_config(sh);
}

static int cmd_bike_set_mqtt_host(const struct shell *sh, size_t argc, char **argv)
{
	ARG_UNUSED(argc);

	int rc = bike_config_set_mqtt_host(argv[1]);

	if (rc) {
		shell_error(sh, "Erro ao salvar MQTT host: %d", rc);
		return rc;
	}

	shell_print(sh, "MQTT host configurado: %s", argv[1]);
	return refresh_state_after_config(sh);
}

static int cmd_bike_set_mqtt_port(const struct shell *sh, size_t argc, char **argv)
{
	ARG_UNUSED(argc);

	uint16_t port;
	int rc = bike_config_parse_mqtt_port(argv[1], &port);

	if (rc) {
		shell_error(sh, "Porta MQTT invalida: %s", argv[1]);
		return rc;
	}

	rc = bike_config_set_mqtt_port(port);
	if (rc) {
		shell_error(sh, "Erro ao salvar MQTT port: %d", rc);
		return rc;
	}

	shell_print(sh, "MQTT port configurado: %u", port);
	return refresh_state_after_config(sh);
}

static int cmd_bike_set_apn(const struct shell *sh, size_t argc, char **argv)
{
	ARG_UNUSED(argc);

	int rc = bike_config_set_apn(argv[1]);

	if (rc) {
		shell_error(sh, "Erro ao salvar APN: %d", rc);
		return rc;
	}

	shell_print(sh, "APN configurado: %s", argv[1]);
	return refresh_state_after_config(sh);
}

static const char *show_string(const char *value)
{
	return value[0] ? value : "(nao definido)";
}

static int cmd_bike_get(const struct shell *sh, size_t argc, char **argv)
{
	const struct bike_config *cfg = bike_config_get();

	ARG_UNUSED(argc);
	ARG_UNUSED(argv);

	shell_print(sh, "ID:        %s", show_string(cfg->id));
	shell_print(sh, "Token:     %s", show_string(cfg->device_token));
	shell_print(sh, "MQTT host: %s", show_string(cfg->mqtt_host));
	if (cfg->mqtt_port) {
		shell_print(sh, "MQTT port: %u", cfg->mqtt_port);
	} else {
		shell_print(sh, "MQTT port: (nao definido)");
	}
	shell_print(sh, "APN:       %s", show_string(cfg->apn));
	shell_print(sh, "Valida:    %s",
		    bike_config_is_valid(cfg) ? "sim" : "nao");
	return 0;
}

static int cmd_bike_state(const struct shell *sh, size_t argc, char **argv)
{
	const char *rental_id = bike_state_get_rental_id();

	ARG_UNUSED(argc);
	ARG_UNUSED(argv);

	shell_print(sh, "Estado: %s", bike_state_name(bike_state_get()));
	if (rental_id[0]) {
		shell_print(sh, "Rental ID: %s", rental_id);
	}
	return 0;
}

static int cmd_bike_sim_authorize(const struct shell *sh, size_t argc, char **argv)
{
	ARG_UNUSED(argc);

	struct bike_backend_command_msg msg = {
		.type = BIKE_BACKEND_RENT_AUTHORIZE,
	};

	strncpy(msg.rental_id, argv[1], sizeof(msg.rental_id) - 1);
	msg.rental_id[sizeof(msg.rental_id) - 1] = '\0';

	int rc = zbus_chan_pub(&backend_command_chan, &msg, K_MSEC(100));

	if (rc) {
		shell_error(sh, "Falha ao publicar comando: %d", rc);
		return rc;
	}

	shell_print(sh, "RENT_AUTHORIZE publicado: %s", msg.rental_id);
	return 0;
}

static int cmd_bike_sim_cancel(const struct shell *sh, size_t argc, char **argv)
{
	struct bike_backend_command_msg msg = {
		.type = BIKE_BACKEND_RENT_CANCEL,
	};

	if (argc > 1) {
		strncpy(msg.rental_id, argv[1], sizeof(msg.rental_id) - 1);
		msg.rental_id[sizeof(msg.rental_id) - 1] = '\0';
	}

	int rc = zbus_chan_pub(&backend_command_chan, &msg, K_MSEC(100));

	if (rc) {
		shell_error(sh, "Falha ao publicar comando: %d", rc);
		return rc;
	}

	shell_print(sh, "RENT_CANCEL publicado");
	return 0;
}

static int cmd_bike_sim_button(const struct shell *sh, size_t argc, char **argv)
{
	ARG_UNUSED(argc);
	ARG_UNUSED(argv);

	struct bike_button_event_msg msg = {
		.uptime_ms = k_uptime_get(),
	};

	int rc = zbus_chan_pub(&button_event_chan, &msg, K_MSEC(100));

	if (rc) {
		shell_error(sh, "Falha ao publicar botao: %d", rc);
		return rc;
	}

	shell_print(sh, "Evento de botao publicado");
	return 0;
}

SHELL_STATIC_SUBCMD_SET_CREATE(sub_bike_set,
	SHELL_CMD_ARG(id, NULL, "<bike_id> Identificador da bicicleta",
		      cmd_bike_set_id, 2, 0),
	SHELL_CMD_ARG(token, NULL, "<device_token> Token do dispositivo",
		      cmd_bike_set_token, 2, 0),
	SHELL_CMD_ARG(mqtt_host, NULL, "<host> Host do broker MQTT",
		      cmd_bike_set_mqtt_host, 2, 0),
	SHELL_CMD_ARG(mqtt_port, NULL, "<port> Porta do broker MQTT",
		      cmd_bike_set_mqtt_port, 2, 0),
	SHELL_CMD_ARG(apn, NULL, "<apn> APN da operadora",
		      cmd_bike_set_apn, 2, 0),
	SHELL_SUBCMD_SET_END
);

SHELL_STATIC_SUBCMD_SET_CREATE(sub_bike_sim,
	SHELL_CMD_ARG(authorize, NULL, "<rental_id> Simula RENT_AUTHORIZE",
		      cmd_bike_sim_authorize, 2, 0),
	SHELL_CMD_ARG(cancel, NULL, "[rental_id] Simula RENT_CANCEL",
		      cmd_bike_sim_cancel, 1, 1),
	SHELL_CMD(button, NULL, "Simula pressionamento do botao",
		  cmd_bike_sim_button),
	SHELL_SUBCMD_SET_END
);

SHELL_STATIC_SUBCMD_SET_CREATE(sub_bike,
	SHELL_CMD(set, &sub_bike_set, "Configura parametros da bicicleta", NULL),
	SHELL_CMD(get, NULL, "Exibe configuracao atual", cmd_bike_get),
	SHELL_CMD(state, NULL, "Exibe estado atual", cmd_bike_state),
	SHELL_CMD(sim, &sub_bike_sim, "Simula eventos do backend e botao", NULL),
	SHELL_SUBCMD_SET_END
);

SHELL_CMD_REGISTER(bike, &sub_bike, "Gerenciamento da bicicleta", NULL);
```

## src/bike_state.c
```c
#include <errno.h>
#include <string.h>

#include <zephyr/kernel.h>
#include <zephyr/logging/log.h>
#include <zephyr/zbus/zbus.h>

#include "app_channels.h"
#include "bike_config.h"
#include "bike_state.h"

LOG_MODULE_REGISTER(bike_state, LOG_LEVEL_INF);

static enum bike_state_value current_state = BIKE_STATE_UNREGISTERED;
static char active_rental_id[BIKE_RENTAL_ID_MAX_LEN];
static int64_t trip_started_at_ms;
static struct k_work_delayable reservation_timeout_work;

static void publish_state(void)
{
	struct bike_state_msg msg = {
		.state = current_state,
		.updated_at_ms = k_uptime_get(),
	};

	strncpy(msg.rental_id, active_rental_id, sizeof(msg.rental_id) - 1);
	msg.rental_id[sizeof(msg.rental_id) - 1] = '\0';

	(void)zbus_chan_pub(&bike_state_chan, &msg, K_NO_WAIT);
}

const char *bike_state_name(enum bike_state_value state)
{
	switch (state) {
	case BIKE_STATE_UNREGISTERED:
		return "UNREGISTERED";
	case BIKE_STATE_AVAILABLE:
		return "AVAILABLE";
	case BIKE_STATE_RESERVED:
		return "RESERVED";
	case BIKE_STATE_IN_USE:
		return "IN_USE";
	case BIKE_STATE_ERROR:
		return "ERROR";
	default:
		return "UNKNOWN";
	}
}

static void set_state(enum bike_state_value next_state)
{
	if (current_state == next_state) {
		publish_state();
		return;
	}

	LOG_INF("Estado: %s -> %s", bike_state_name(current_state),
		bike_state_name(next_state));
	current_state = next_state;
	publish_state();
}

static void clear_rental(void)
{
	active_rental_id[0] = '\0';
	trip_started_at_ms = 0;
	(void)k_work_cancel_delayable(&reservation_timeout_work);
}

bool bike_state_is_config_valid(void)
{
	return bike_config_is_valid(bike_config_get());
}

int bike_state_refresh_config(void)
{
	if (current_state == BIKE_STATE_ERROR ||
	    current_state == BIKE_STATE_RESERVED ||
	    current_state == BIKE_STATE_IN_USE) {
		return 0;
	}

	set_state(bike_state_is_config_valid() ? BIKE_STATE_AVAILABLE :
		  BIKE_STATE_UNREGISTERED);
	return 0;
}

static void reservation_timeout_handler(struct k_work *work)
{
	ARG_UNUSED(work);

	if (current_state != BIKE_STATE_RESERVED) {
		return;
	}

	LOG_WRN("Reserva %s expirada", active_rental_id);
	clear_rental();
	set_state(BIKE_STATE_AVAILABLE);
}

int bike_state_init(void)
{
	k_work_init_delayable(&reservation_timeout_work,
			      reservation_timeout_handler);
	current_state = bike_state_is_config_valid() ? BIKE_STATE_AVAILABLE :
			BIKE_STATE_UNREGISTERED;
	publish_state();
	LOG_INF("Estado inicial: %s", bike_state_name(current_state));
	return 0;
}

enum bike_state_value bike_state_get(void)
{
	return current_state;
}

const char *bike_state_get_rental_id(void)
{
	return active_rental_id;
}

int bike_state_authorize(const char *rental_id)
{
	size_t len;

	if (!rental_id || !rental_id[0]) {
		LOG_WRN("RENT_AUTHORIZE rejeitado: rental_id ausente");
		return -EINVAL;
	}

	len = strlen(rental_id);
	if (len >= sizeof(active_rental_id)) {
		LOG_WRN("RENT_AUTHORIZE rejeitado: rental_id longo demais");
		return -EINVAL;
	}

	if (current_state != BIKE_STATE_AVAILABLE) {
		LOG_WRN("RENT_AUTHORIZE rejeitado no estado %s",
			bike_state_name(current_state));
		return -EACCES;
	}

	memcpy(active_rental_id, rental_id, len + 1);
	trip_started_at_ms = 0;
	(void)k_work_reschedule(&reservation_timeout_work,
				 K_SECONDS(BIKE_RESERVATION_TIMEOUT_SECONDS));
	set_state(BIKE_STATE_RESERVED);
	return 0;
}

int bike_state_cancel(const char *rental_id)
{
	if (current_state != BIKE_STATE_RESERVED) {
		LOG_WRN("RENT_CANCEL rejeitado no estado %s",
			bike_state_name(current_state));
		return -EACCES;
	}

	if (rental_id && rental_id[0] &&
	    strcmp(rental_id, active_rental_id) != 0) {
		LOG_WRN("RENT_CANCEL rejeitado: rental_id divergente");
		return -EINVAL;
	}

	clear_rental();
	set_state(BIKE_STATE_AVAILABLE);
	return 0;
}

int bike_state_button_press(void)
{
	switch (current_state) {
	case BIKE_STATE_RESERVED:
		(void)k_work_cancel_delayable(&reservation_timeout_work);
		trip_started_at_ms = k_uptime_get();
		set_state(BIKE_STATE_IN_USE);
		return 0;
	case BIKE_STATE_IN_USE:
		LOG_INF("Viagem finalizada apos %lld ms",
			k_uptime_get() - trip_started_at_ms);
		clear_rental();
		set_state(BIKE_STATE_AVAILABLE);
		return 0;
	default:
		LOG_WRN("Botao ignorado no estado %s",
			bike_state_name(current_state));
		return -EACCES;
	}
}

static void backend_command_listener(const struct zbus_channel *chan)
{
	const struct bike_backend_command_msg *msg = zbus_chan_const_msg(chan);

	switch (msg->type) {
	case BIKE_BACKEND_RENT_AUTHORIZE:
		(void)bike_state_authorize(msg->rental_id);
		break;
	case BIKE_BACKEND_RENT_CANCEL:
		(void)bike_state_cancel(msg->rental_id);
		break;
	default:
		LOG_WRN("Comando backend desconhecido: %d", msg->type);
		break;
	}
}

static void button_event_listener(const struct zbus_channel *chan)
{
	ARG_UNUSED(chan);

	(void)bike_state_button_press();
}

ZBUS_LISTENER_DEFINE(backend_command_listener_node, backend_command_listener);
ZBUS_CHAN_ADD_OBS(backend_command_chan, backend_command_listener_node, 0);

ZBUS_LISTENER_DEFINE(button_event_listener_node, button_event_listener);
ZBUS_CHAN_ADD_OBS(button_event_chan, button_event_listener_node, 0);
```

## src/button_input.c
```c
#include <errno.h>

#include <zephyr/devicetree.h>
#include <zephyr/kernel.h>
#include <zephyr/logging/log.h>
#include <zephyr/zbus/zbus.h>

#include "app_channels.h"
#include "button_input.h"

#if defined(CONFIG_GPIO) && DT_NODE_HAS_STATUS(DT_ALIAS(sw0), okay)
#include <zephyr/drivers/gpio.h>
#define BUTTON_INPUT_HAS_GPIO 1
#else
#define BUTTON_INPUT_HAS_GPIO 0
#endif

LOG_MODULE_REGISTER(button_input, LOG_LEVEL_INF);

#if BUTTON_INPUT_HAS_GPIO
static const struct gpio_dt_spec button = GPIO_DT_SPEC_GET(DT_ALIAS(sw0), gpios);
static struct gpio_callback button_cb;
#endif

static struct k_work button_work;
static int64_t last_published_press_ms = -BUTTON_INPUT_DEBOUNCE_MS;

int button_input_publish_press(int64_t uptime_ms)
{
	struct bike_button_event_msg msg = {
		.uptime_ms = uptime_ms,
	};

	return zbus_chan_pub(&button_event_chan, &msg, K_MSEC(100));
}

int button_input_publish_press_debounced(int64_t uptime_ms)
{
	if ((uptime_ms - last_published_press_ms) < BUTTON_INPUT_DEBOUNCE_MS) {
		LOG_WRN("Botao ignorado por debounce");
		return -EALREADY;
	}

	int rc = button_input_publish_press(uptime_ms);

	if (!rc) {
		last_published_press_ms = uptime_ms;
	}

	return rc;
}

void button_input_reset_debounce(void)
{
	last_published_press_ms = -BUTTON_INPUT_DEBOUNCE_MS;
}

static void button_work_handler(struct k_work *work)
{
	int rc;

	ARG_UNUSED(work);

	rc = button_input_publish_press_debounced(k_uptime_get());
	if (rc) {
		LOG_WRN("Falha ao publicar botao: %d", rc);
	}
}

#if BUTTON_INPUT_HAS_GPIO
static void button_gpio_callback(const struct device *dev,
				 struct gpio_callback *cb, uint32_t pins)
{
	ARG_UNUSED(dev);
	ARG_UNUSED(cb);
	ARG_UNUSED(pins);

	k_work_submit(&button_work);
}
#endif

int button_input_init(void)
{
	k_work_init(&button_work, button_work_handler);

#if BUTTON_INPUT_HAS_GPIO
	int rc;

	if (!gpio_is_ready_dt(&button)) {
		LOG_ERR("Botao sw0 nao esta pronto");
		return -ENODEV;
	}

	rc = gpio_pin_configure_dt(&button, GPIO_INPUT);
	if (rc) {
		LOG_ERR("Falha ao configurar botao sw0: %d", rc);
		return rc;
	}

	gpio_init_callback(&button_cb, button_gpio_callback, BIT(button.pin));
	rc = gpio_add_callback(button.port, &button_cb);
	if (rc) {
		LOG_ERR("Falha ao registrar callback sw0: %d", rc);
		return rc;
	}

	rc = gpio_pin_interrupt_configure_dt(&button, GPIO_INT_EDGE_TO_ACTIVE);
	if (rc) {
		LOG_ERR("Falha ao configurar interrupcao sw0: %d", rc);
		return rc;
	}

	LOG_INF("Botao sw0 inicializado");
#else
	LOG_WRN("Alias sw0 indisponivel; botao fisico desabilitado");
#endif

	return 0;
}
```

## src/led_status.c
```c
#include <errno.h>

#include <zephyr/devicetree.h>
#include <zephyr/kernel.h>
#include <zephyr/logging/log.h>
#include <zephyr/zbus/zbus.h>

#include "app_channels.h"
#include "led_status.h"

#if defined(CONFIG_GPIO) && DT_NODE_HAS_STATUS(DT_ALIAS(led0), okay)
#include <zephyr/drivers/gpio.h>
#define LED_STATUS_HAS_GPIO 1
#else
#define LED_STATUS_HAS_GPIO 0
#endif

LOG_MODULE_REGISTER(led_status, LOG_LEVEL_INF);

#if LED_STATUS_HAS_GPIO
static const struct gpio_dt_spec led = GPIO_DT_SPEC_GET(DT_ALIAS(led0), gpios);
#endif

static enum led_status_pattern current_pattern = LED_STATUS_OFF;
static struct k_work_delayable blink_work;
static bool led_is_on;
static bool initialized;

enum led_status_pattern led_status_pattern_for_state(enum bike_state_value state)
{
	switch (state) {
	case BIKE_STATE_UNREGISTERED:
		return LED_STATUS_OFF;
	case BIKE_STATE_AVAILABLE:
		return LED_STATUS_BLINK_SLOW;
	case BIKE_STATE_RESERVED:
		return LED_STATUS_BLINK_FAST;
	case BIKE_STATE_IN_USE:
		return LED_STATUS_SOLID_ON;
	case BIKE_STATE_ERROR:
		return LED_STATUS_ERROR;
	default:
		return LED_STATUS_ERROR;
	}
}

enum led_status_pattern led_status_get_pattern(void)
{
	return current_pattern;
}

bool led_status_is_on(void)
{
	return led_is_on;
}

const char *led_status_pattern_name(enum led_status_pattern pattern)
{
	switch (pattern) {
	case LED_STATUS_OFF:
		return "OFF";
	case LED_STATUS_SOLID_ON:
		return "SOLID_ON";
	case LED_STATUS_BLINK_SLOW:
		return "BLINK_SLOW";
	case LED_STATUS_BLINK_FAST:
		return "BLINK_FAST";
	case LED_STATUS_ERROR:
		return "ERROR";
	default:
		return "UNKNOWN";
	}
}

static void write_led(bool on)
{
	led_is_on = on;

#if LED_STATUS_HAS_GPIO
	if (initialized) {
		(void)gpio_pin_set_dt(&led, on ? 1 : 0);
	}
#endif
}

static k_timeout_t blink_interval(enum led_status_pattern pattern)
{
	switch (pattern) {
	case LED_STATUS_BLINK_SLOW:
		return K_MSEC(1000);
	case LED_STATUS_BLINK_FAST:
		return K_MSEC(250);
	case LED_STATUS_ERROR:
		return K_MSEC(150);
	default:
		return K_FOREVER;
	}
}

static bool pattern_blinks(enum led_status_pattern pattern)
{
	return pattern == LED_STATUS_BLINK_SLOW ||
	       pattern == LED_STATUS_BLINK_FAST ||
	       pattern == LED_STATUS_ERROR;
}

static void blink_handler(struct k_work *work)
{
	ARG_UNUSED(work);

	if (!pattern_blinks(current_pattern)) {
		return;
	}

	write_led(!led_is_on);
	(void)k_work_reschedule(&blink_work, blink_interval(current_pattern));
}

static void apply_pattern(enum led_status_pattern pattern, bool force)
{
	if (!initialized) {
		current_pattern = pattern;
		return;
	}

	if (current_pattern == pattern && !force) {
		return;
	}

	current_pattern = pattern;
	(void)k_work_cancel_delayable(&blink_work);

	switch (pattern) {
	case LED_STATUS_OFF:
		write_led(false);
		break;
	case LED_STATUS_SOLID_ON:
		write_led(true);
		break;
	case LED_STATUS_BLINK_SLOW:
	case LED_STATUS_BLINK_FAST:
	case LED_STATUS_ERROR:
		write_led(true);
		(void)k_work_reschedule(&blink_work, blink_interval(pattern));
		break;
	default:
		write_led(false);
		break;
	}

	LOG_INF("Padrao LED: %s", led_status_pattern_name(pattern));
}

int led_status_init(void)
{
	k_work_init_delayable(&blink_work, blink_handler);

#if LED_STATUS_HAS_GPIO
	if (!gpio_is_ready_dt(&led)) {
		LOG_ERR("LED led0 nao esta pronto");
		return -ENODEV;
	}

	int rc = gpio_pin_configure_dt(&led, GPIO_OUTPUT_INACTIVE);

	if (rc) {
		LOG_ERR("Falha ao configurar LED led0: %d", rc);
		return rc;
	}
#else
	LOG_WRN("Alias led0 indisponivel; LED mantido em modo logico");
#endif

	initialized = true;
	apply_pattern(current_pattern, true);
	return 0;
}

static void bike_state_listener(const struct zbus_channel *chan)
{
	const struct bike_state_msg *msg = zbus_chan_const_msg(chan);

	apply_pattern(led_status_pattern_for_state(msg->state), false);
}

ZBUS_LISTENER_DEFINE(led_status_state_listener, bike_state_listener);
ZBUS_CHAN_ADD_OBS(bike_state_chan, led_status_state_listener, 0);
```
